## sound/soc/loongson/Kconfig
```kconfig
# SPDX-License-Identifier: GPL-2.0
menu "SoC Audio for Loongson CPUs"

config SND_SOC_LOONGSON_I2S_PCI
	tristate "Loongson I2S-PCI Device Driver"
	select REGMAP_MMIO
	depends on PCI
	help
	  Say Y or M if you want to add support for I2S driver for
	  Loongson I2S controller.

	  The controller is found in loongson bridge chips or SoCs,
	  and work as a PCI device.

config SND_SOC_LOONGSON_CARD
	tristate "Loongson Sound Card Driver"
	select SND_SOC_LOONGSON_I2S_PCI
	depends on PCI
	help
	  Say Y or M if you want to add support for SoC audio using
	  loongson I2S controller.

	  The driver add support for ALSA SoC Audio support using
	  loongson I2S controller.

config SND_LS_I2S
	tristate "SoC Audio for ls-i2s"
	default n
	help
	  Say Y or M if you want to add support for codecs attached to
	  the I2S interface. You will also need to select the Audio
		interfaces to support below.

config SND_LS_PCM
	tristate "SoC Audio for ls-pcm"
	default n
	help
	Say Y or M if you want to add support for codecs attached to
	the PCM interface. You will also need to select the Audio
		interfaces to support below.

config SND_LS_SOUND
	default n
	tristate "SoC Audio for ls-sound"

config SND_LS_2K300
	bool "SoC Audio for ls-2k300"
	default n

endmenu
```
